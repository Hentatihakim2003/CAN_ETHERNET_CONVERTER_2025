VERSION "1.0"

NS_ :

BS_:

BU_: ECUs

BO_ 1 buttonWiperIgnition: 1 ECUs
 SG_ buttonWiperIgnition : 0|8@1+ (1,0) [0|1] ""  Receiver

BO_ 2 buttonWiperRequestOperation: 1 ECUs
 SG_ buttonWiperRequestOperation : 0|8@1+ (1,0) [3|6] ""  Receiver

BO_ 4 buttonReverseGear: 1 ECUs
 SG_ buttonReverseGear : 0|8@1+ (1,0) [2|3] ""  Receiver

VAL_ 1 buttonWiperIgnition 0 "OFF" 1 "ON";

VAL_ 4 buttonReverseGear 2 "0" 3 "1";

VAL_ 2 buttonWiperRequestOperation 3 "1" 4 "2" 5 "3" 6 "4";
